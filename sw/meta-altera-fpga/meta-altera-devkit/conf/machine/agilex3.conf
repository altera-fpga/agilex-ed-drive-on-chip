## sw/meta-altera-fpga/meta-altera-devkit/conf/machine/agilex3.conf
```bitbake
#@TYPE: Machine
#@NAME: Intel SoCFPGA Agilex3
#@DESCRIPTION: Machine configuration for the Agilex3

require conf/machine/include/agilex3-devkit.inc
```

## sw/meta-altera-fpga/meta-altera-devkit/conf/machine/agilex5_dk_a5e065bb32aes.conf
```bitbake
#@TYPE: Machine
#@NAME: Intel SoCFPGA Agilex5
#@DESCRIPTION: Machine configuration for the Agilex5 SoCFPGA

require conf/machine/include/agilex5-devkit.inc

# Define multilib target
require conf/multilib.conf
MULTILIBS = "multilib:lib32"
DEFAULTTUNE:virtclass-multilib-lib32 = "armv7athf-neon"

# Specify the 32-bit libraries to be added to all images
IMAGE_INSTALL:append = " lib32-zlib"

UBOOT_CONFIG[agilex5-socdk-nand-atf] = "socfpga_agilex5_nand2_defconfig"
```

## sw/meta-altera-fpga/meta-altera-devkit/conf/machine/agilex7_dk_dev_agf027f1es.conf
```bitbake
#@TYPE: Machine
#@NAME: Intel SoCFPGA Agilex7 DK-DEV-AGF027F1ES
#@DESCRIPTION: Machine configuration for the Agilex7 DK-DEV-AGF027F1ES SoCFPGA

require conf/machine/include/agilex7-devkit.inc
```

## sw/meta-altera-fpga/meta-altera-devkit/conf/machine/agilex7_dk_dev_agm039fes.conf
```bitbake
#@TYPE: Machine
#@NAME: Intel SoCFPGA Agilex7 DK-DEV-AGM039FES
#@DESCRIPTION: Machine configuration for the Agilex7 DK-DEV-AGM039FES SoCFPGA

DTS_NAME = "socfpga_agilex7m_socdk"

UBOOT_CONFIG[agilex-socdk-atf] = "socfpga_agilex7m_defconfig"
UBOOT_CONFIG[agilex-socdk-qspi-atf] = "socfpga_agilex7m_defconfig"

require conf/machine/include/agilex7-devkit.inc
```

## sw/meta-altera-fpga/meta-altera-devkit/conf/machine/agilex7_dk_si_agf014ea.conf
```bitbake
#@TYPE: Machine
#@NAME: Intel SoCFPGA Agilex7 DK-SI-AGF014E
#@DESCRIPTION: Machine configuration for the Agilex7 DK-SI-AGF014E SoCFPGA

DTS_NAME = "socfpga_agilex_socdk"

require conf/machine/include/agilex7-devkit.inc
```

## sw/meta-altera-fpga/meta-altera-devkit/conf/machine/agilex7_dk_si_agi027fa.conf
```bitbake
#@TYPE: Machine
#@NAME: Intel SoCFPGA Agilex7 DK-SI-AGI027F
#@DESCRIPTION: Machine configuration for the Agilex7 DK-SI-AGI027F SoCFPGA

require conf/machine/include/agilex7-devkit.inc
```

## sw/meta-altera-fpga/meta-altera-devkit/conf/machine/include/agilex3-devkit.inc
```bitbake
UBOOT_CONFIG ??= "agilex3-socdk-atf"
UBOOT_CONFIG[agilex3-socdk-atf] = "socfpga_agilex3_defconfig"

DTS_NAME ?= "socfpga_agilex3_socdk"

require conf/machine/include/agilex3.inc
```

## sw/meta-altera-fpga/meta-altera-devkit/conf/machine/include/agilex5-moddevkit.inc
```bitbake
DTS_NAME ?= "socfpga_agilex5_socdk_modular"

UBOOT_CONFIG ??= "agilex5-socdk-atf"
UBOOT_CONFIG[agilex5-socdk-atf] = "socfpga_agilex5_modular_defconfig"

require conf/machine/include/agilex5.inc
```

## sw/meta-altera-fpga/meta-altera-devkit/conf/machine/include/agilex7-devkit.inc
```bitbake
UBOOT_CONFIG ??= "agilex-socdk-atf"
UBOOT_CONFIG[agilex-socdk] = "socfpga_agilex_legacy_defconfig"
UBOOT_CONFIG[agilex-socdk-atf] = "socfpga_agilex_defconfig"
UBOOT_CONFIG[agilex-socdk-qspi] = "socfpga_agilex_qspi_legacy_defconfig"
UBOOT_CONFIG[agilex-socdk-qspi-atf] = "socfpga_agilex_defconfig"

DTS_NAME ?= "socfpga_agilex_socdk"

require conf/machine/include/agilex7.inc
```

## sw/meta-altera-fpga/meta-altera-vendor/conf/layer.conf
```bitbake
# We have a conf and classes directory, append to BBPATH
BBPATH .= ":${LAYERDIR}"

# We have a recipes directory, add to BBFILES
BBFILES += "${LAYERDIR}/recipes*/*/*.bb ${LAYERDIR}/recipes*/*/*.bbappend"

BBFILE_COLLECTIONS += "altera-vendor-layer"
BBFILE_PATTERN_altera-vendor-layer := "^${LAYERDIR}/"
BBFILE_PRIORITY_altera-vendor-layer = "12"

# This should only be incremented on significant changes that will
# cause compatibility issues with other layers
LAYERVERSION_altera-vendor-layer = "1"
LAYERSERIES_COMPAT_altera-vendor-layer = "scarthgap"
LAYERDEPENDS_altera-vendor-layer = " \
    core \
    altera-bsp-layer \
"
```

## sw/meta-altera-fpga/meta-altera-vendor/conf/machine/agilex5_axe5_eagle.conf
```bitbake
#@TYPE: Machine
#@NAME: Arrow AXE5-Eagle
#@DESCRIPTION: Machine configuration for the Arrow AXE5-Eagle development board

DTS_NAME = "socfpga_agilex5_axe5_eagle"

UBOOT_CONFIG ?= "agilex5-socdk-atf"
UBOOT_CONFIG[agilex5-socdk-atf] = "socfpga_agilex5_axe5_eagle_defconfig"

require conf/machine/include/agilex5.inc
```

## sw/meta-altera-fpga/meta-altera-vendor/conf/machine/agilex5_sulfur.conf
```bitbake
#@TYPE: Machine
#@NAME: Macnica Sulfur
#@DESCRIPTION: Machine configuration for the Macnica Sulfur board

DTS_NAME = "socfpga_agilex5_sulfur"

UBOOT_CONFIG ?= "agilex5-socdk-atf"
UBOOT_CONFIG[agilex5-socdk-atf] = "socfpga_agilex5_sulfur_defconfig"

require conf/machine/include/agilex5.inc
```

## sw/meta-driveonchip/conf/layer.conf
```bitbake
# We have a conf and classes directory, append to BBPATH
BBPATH .= ":${LAYERDIR}"

# We have a recipes directory, add to BBFILES
BBFILES += "${LAYERDIR}/recipes*/*/*.bb ${LAYERDIR}/recipes*/*/*.bbappend"

BBFILE_COLLECTIONS += "driveonchip-layer"
BBFILE_PATTERN_driveonchip-layer := "^${LAYERDIR}/"
BBFILE_PRIORITY_driveonchip-layer = "12"

# This should only be incremented on significant changes that will
# cause compatibility issues with other layers
LAYERVERSION_driveonchip-layer = "1"
LAYERSERIES_COMPAT_driveonchip-layer = "scarthgap"
```

## sw/meta-fpga-embedded/conf/layer.conf
```bitbake
# We have a conf and classes directory, append to BBPATH
BBPATH .= ":${LAYERDIR}"

# We have a recipes directory, add to BBFILES
BBFILES += "${LAYERDIR}/recipes*/*/*.bb ${LAYERDIR}/recipes*/*/*.bbappend"

BBFILE_COLLECTIONS += "fpga-embedded-layer"
BBFILE_PATTERN_fpga-embedded-layer := "^${LAYERDIR}/"
BBFILE_PRIORITY_fpga-embedded-layer = "10"

BBFILES_DYNAMIC += " \
    virtualization-layer:${LAYERDIR}/dynamic-layers/virtualization-layer/*/*/*.bb \
    virtualization-layer:${LAYERDIR}/dynamic-layers/virtualization-layer/*/*/*.bbappend \
"

# This should only be incremented on significant changes that will
# cause compatibility issues with other layers
LAYERVERSION_fpga-embedded-layer = "1"
LAYERSERIES_COMPAT_fpga-embedded-layer = "scarthgap"
LAYERDEPENDS_fpga-embedded-layer = " \
    core \
    meta-intel-fpga \
"
```
